&pinctrl {
    uart0_default: uart0_default {
		group1 {
			psels = <NRF_PSEL(UART_TX, 0, 9)>;
		};

		group2 {
			psels = <NRF_PSEL(UART_RX, 0, 10)>;
			bias-pull-up;
		};
	};

	// uart0_sleep: uart0_sleep {
	// 	group1 {
	// 		psels = <NRF_PSEL(UART_TX, 0, 9)>,
    //                 <NRF_PSEL(UART_RX, 0, 10)>;
	// 		low-power-enable;
	// 	};
	// };

    // uart1_default: uart1_default {
	// 	group1 {
	// 		psels = <NRF_PSEL(UART_TX, 0, 15)>;
	// 	};

	// 	group2 {
	// 		psels = <NRF_PSEL(UART_RX, 0, 17)>;
	// 		bias-pull-up;
	// 	};
	// };

	// uart1_sleep: uart1_sleep {
	// 	group1 {
	// 		psels = <NRF_PSEL(UART_TX, 0, 15)>,
    //                 <NRF_PSEL(UART_RX, 0, 17)>;
	// 		low-power-enable;
	// 	};
	// };
};